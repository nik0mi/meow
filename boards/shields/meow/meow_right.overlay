#include "meow.dtsi"

/ {
    kscan0: kscan0 {
        compatible = "zmk,kscan-gpio-direct";
        wakeup-source;

        input-gpios
            = <&gpio1 13 (GPIO_ACTIVE_LOW | GPIO_PULL_UP)>
            , <&gpio1 15 (GPIO_ACTIVE_LOW | GPIO_PULL_UP)>
            , <&gpio0 2 (GPIO_ACTIVE_LOW | GPIO_PULL_UP)>
            , <&gpio0 29 (GPIO_ACTIVE_LOW | GPIO_PULL_UP)>
            , <&gpio0 31 (GPIO_ACTIVE_LOW | GPIO_PULL_UP)>
            , <&gpio0 20 (GPIO_ACTIVE_LOW | GPIO_PULL_UP)>
            , <&gpio0 17 (GPIO_ACTIVE_LOW | GPIO_PULL_UP)>
            , <&gpio0 9 (GPIO_ACTIVE_LOW | GPIO_PULL_UP)>
            , <&gpio0 10 (GPIO_ACTIVE_LOW | GPIO_PULL_UP)>
            , <&gpio1 11 (GPIO_ACTIVE_LOW | GPIO_PULL_UP)>
            , <&gpio0 11 (GPIO_ACTIVE_LOW | GPIO_PULL_UP)>
            , <&gpio1 0 (GPIO_ACTIVE_LOW | GPIO_PULL_UP)>
            , <&gpio0 24 (GPIO_ACTIVE_LOW | GPIO_PULL_UP)>
            , <&gpio0 22 (GPIO_ACTIVE_LOW | GPIO_PULL_UP)>
            , <&gpio0 6 (GPIO_ACTIVE_LOW | GPIO_PULL_UP)>
            , <&gpio1 6 (GPIO_ACTIVE_LOW | GPIO_PULL_UP)>
            , <&gpio1 4 (GPIO_ACTIVE_LOW | GPIO_PULL_UP)>
            ;
    };
};

&matrix_transform0 {
    row-offset = <1>;
};

&physical_layout_meow {
    kscan = <&kscan0>;
};