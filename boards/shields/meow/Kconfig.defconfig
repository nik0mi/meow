## boards/shields/meow/Kconfig.defconfig
```kconfig
if SHIELD_MEOW_DONGLE

config ZMK_KEYBOARD_NAME
    default "meow"

config ZMK_SPLIT_ROLE_CENTRAL
    default y

endif

if SHIELD_MEOW_DONGLE || SHIELD_MEOW_LEFT || SHIELD_MEOW_RIGHT

config ZMK_SPLIT
    default y

endif
```

## boards/shields/meow/Kconfig.shield
```kconfig
config SHIELD_MEOW_LEFT
    def_bool $(shields_list_contains,meow_left)

config SHIELD_MEOW_RIGHT
    def_bool $(shields_list_contains,meow_right)

config SHIELD_MEOW_DONGLE
    def_bool $(shields_list_contains,meow_dongle)
```
